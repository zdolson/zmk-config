## config/boards/shields/knob_knob/Kconfig.defconfig
```kconfig
# Copyright (c) 2022 The ZMK Contributors
# SPDX-License-Identifier: MIT

if SHIELD_KNOB_KNOB

config ZMK_KEYBOARD_NAME
    default "Knob Knob"

endif # SHIELD_KNOB_KNOB
```

## config/boards/shields/knob_knob/Kconfig.shield
```kconfig
# Copyright (c) 2023 The ZMK Contributors
# SPDX-License-Identifier: MIT

config SHIELD_KNOB_KNOB
    def_bool $(shields_list_contains,knob_knob)
```

## config/west.yml
```yaml
manifest:
  remotes:
    - name: zmkfirmware
      url-base: https://github.com/zmkfirmware
    # - name: petejohanson
    #   url-base: https://github.com/petejohanson/
  projects:
    - name: zmk
      remote: zmkfirmware
      revision: main
      # remote: petejohanson
      # revision: sensors/encoder-inc-dec-handle-more-ticks
      import: app/west.yml
  self:
    path: config
```
